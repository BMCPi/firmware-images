/dts-v1/;
/plugin/;

/ {
	compatible = "brcm,bcm2712";

	/*
	 * Advertise OP-TEE (SMC transport) so U-Boot's and Linux's OP-TEE
	 * drivers bind. U-Boot needs this node to probe the EFI variable
	 * MM transport (StandaloneMM hosted by OP-TEE).
	 */
	fragment@0 {
		target = <&firmware>;
		__overlay__ {
			optee {
				compatible = "linaro,optee-tz";
				method = "smc";
			};
		};
	};
};
